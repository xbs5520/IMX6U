## OS/Uboot/OriginalNXPCode/U-boot/board/freescale/mx6ull_bryan_emmc/Kconfig
```kconfig
if TARGET_MX6ULL_14X14_EVK || TARGET_MX6ULL_9X9_EVK

config SYS_BOARD
	default "mx6ull_bryan_emmc"

config SYS_VENDOR
	default "freescale"

config SYS_CONFIG_NAME
	default "mx6ull_bryan_emmc"

endif
```
